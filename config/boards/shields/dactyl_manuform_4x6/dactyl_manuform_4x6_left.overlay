#include "dactyl_manuform_4x6.dtsi"

// Left half rows, top-to-bottom, thumb last
//   row 0 (top finger)   D10
//   row 1                D16
//   row 2                D14
//   row 3 (2 extras)     D15
//   row 4 (thumb x6)     D18
&kscan0 {
    row-gpios
        = <&pro_micro 10 (GPIO_ACTIVE_HIGH | GPIO_PULL_DOWN)>
        , <&pro_micro 16 (GPIO_ACTIVE_HIGH | GPIO_PULL_DOWN)>
        , <&pro_micro 14 (GPIO_ACTIVE_HIGH | GPIO_PULL_DOWN)>
        , <&pro_micro 15 (GPIO_ACTIVE_HIGH | GPIO_PULL_DOWN)>
        , <&pro_micro 18 (GPIO_ACTIVE_HIGH | GPIO_PULL_DOWN)>
        ;
};
